AUTOSAR XML (schema 4-3-0)
package /InitialEcuC
  ecuc value collection InitialEcuC
