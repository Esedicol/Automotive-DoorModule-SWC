AUTOSAR XML (schema 4-3-0)
package /ComponentTypes
  sensor actuator sw component type CtTemperatureReader
    provide port PpCANbusTemperature: nonqueued-sender-com-spec{data-element=DeTemp, init-value=0}, provided-interface=PiTemperature
    behavior CtTemperatureReader_InternalBehavior
  swc implementation CtTemperatureReader_Implementation: behavior=CtTemperatureReader_InternalBehavior
