AUTOSAR XML (schema 4-3-0)
package /ComponentTypes
  composition sw component type CtCoEngineState
    15 x component:
      CpCoWindowLogic: type=CtCoWindowLogic
      CpSaFrontLeft: type=CtSaWindow
      CpSaFrontLeftWindowSwitch: type=CtSaWindowSwitch
      CpSaFrontRight: type=CtSaWindow
      CpSaFrontRightWindowSwitch: type=CtSaWindowSwitch
      CpSaJoypadX: type=CtSaJoypadX
      CpSaJoypadY: type=CtSaJoypadY
      CpSaLeftSideMirror: type=CtSaSideMirror
      CpSaRearLeft: type=CtSaWindow
      CpSaRearRight: type=CtSaWindow
      CpSaRightSideMirror: type=CtSaSideMirror
      CpSaSideMirrorSwitch: type=CtSaSideMirrorSwitch
      CpSaWindowLockSwitch: type=CtSaWindowLockSwitch
      CpSsRearLeftWindowSwitch: type=CtSaWindowSwitch
      CpSsRearRightWindowSwitch: type=CtSaWindowSwitch
