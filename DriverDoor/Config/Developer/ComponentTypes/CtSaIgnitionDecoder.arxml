AUTOSAR XML (schema 4-3-0)
package /ComponentTypes
  sensor actuator sw component type CtSaIgnitionDecoder
    require port PpIgnitionState: nonqueued-receiver-com-spec=data-element=DeIgnitionState, required-interface=PiIgnitionState
    behavior CtSaIgnitionDecoder_InternalBehavior
  swc implementation CtSaIgnitionDecoder_Implementation: behavior=CtSaIgnitionDecoder_InternalBehavior
