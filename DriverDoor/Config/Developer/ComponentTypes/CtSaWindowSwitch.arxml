AUTOSAR XML (schema 4-3-0)
package /ComponentTypes
  sensor actuator sw component type CtSaWindowSwitch
    provide port PiWindowSwitchState: provided-com-specs=[DeWindowSwitchState, Element], provided-interface=PiWindowSwitchState
    behavior CtSaWindowSwitch_InternalBehavior
  swc implementation CtSaWindowSwitch_Implementation: behavior=CtSaWindowSwitch_InternalBehavior
