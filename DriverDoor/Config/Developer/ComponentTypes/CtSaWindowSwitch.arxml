AUTOSAR XML (schema 4-3-0)
package /ComponentTypes
  sensor actuator sw component type CtSaWindowSwitch
    behavior CtSaWindowSwitch_InternalBehavior
  swc implementation CtSaWindowSwitch_Implementation: behavior=CtSaWindowSwitch_InternalBehavior
