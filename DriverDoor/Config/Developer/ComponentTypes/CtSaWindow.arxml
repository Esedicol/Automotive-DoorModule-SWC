AUTOSAR XML (schema 4-3-0)
package /ComponentTypes
  application sw component type CtSaWindow
    behavior CtSaWindow_InternalBehavior
  swc implementation CtSaWindow_Implementation: behavior=CtSaWindow_InternalBehavior
