AUTOSAR XML (schema 4-3-0)
package /ECUCompositionTypes
  composition sw component type ECU_Composition
    5 x component:
      CpCoWindowLogic: type=CtCoWindowLogic
      CpSaFrontLeftWindowSwitch: type=CtSaWindowSwitch
      CpSaFrontRightWindowSwitch: type=CtSaWindowSwitch
      CpSsRearLeftWindowSwitch: type=CtSaWindowSwitch
      CpSsRearRightWindowSwitch: type=CtSaWindowSwitch
package /EndToEndProtections
  end to end protection set EndToEndProtectionSet
package /Systems
  system DoorECU
    root-software-compositions:
      root sw composition prototype EcuSwComposition: software-composition=ECU_Composition
