AUTOSAR XML (schema 4-3-0)
package /ECUCompositionTypes
  composition sw component type ECU_Composition
    14 x component:
      CpCoWindowLogic: type=CtCoWindowLogic
      CpSaFrontLeftWindowSwitch: type=CtSaWindowSwitch
      CpSaFrontRightWindowSwitch: type=CtSaWindowSwitch
      CpSsRearLeftWindowSwitch: type=CtSaWindowSwitch
      CpSsRearRightWindowSwitch: type=CtSaWindowSwitch
      CpSaFrontLeft: type=CtSaWindow
      CpSaFrontRight: type=CtSaWindow
      CpSaRearLeft: type=CtSaWindow
      CpSaRearRight: type=CtSaWindow
      CpSaLeftSideMirror: type=CtSaSideMirror
      CpSaRightSideMirror: type=CtSaSideMirror
      CpSaSideMirrorSwitch: type=CtSaSideMirrorSwitch
      CtHwAbIO: type=CtHwAbIO
      CpSaWindowLockSwitch: type=CtSaWindowLockSwitch
    connect CpSaFrontLeftWindowSwitch.PpWindowSwitchState -> CpCoWindowLogic.PpFrontLeftWindowSwitchState
    connect CpSaFrontRightWindowSwitch.PpWindowSwitchState -> CpCoWindowLogic.PpFrontRightWindowSwitchState
    connect CpSsRearLeftWindowSwitch.PpWindowSwitchState -> CpCoWindowLogic.PpRearLeftWindowSwitchState
    connect CpSsRearRightWindowSwitch.PpWindowSwitchState -> CpCoWindowLogic.PpRearRightWindowSwitchState
    connect CpSaSideMirrorSwitch.PpSideMirrorSwitchState -> CpCoWindowLogic.PpSideMirrorSwitch
    connect CpCoWindowLogic.PpFrontLeftWindowState -> CpSaFrontLeft.PpWindowState
    connect CpCoWindowLogic.PpRearLeftWindowState -> CpSaRearLeft.PpWindowState
    connect CpCoWindowLogic.PpRearRightWindowState -> CpSaRearRight.PpWindowState
    connect CpCoWindowLogic.PpFrontRightWindowState -> CpSaFrontRight.PpWindowState
    connect CpCoWindowLogic.PpLeftSideMirrorState -> CpSaLeftSideMirror.PpSideMirrorState
    connect CpCoWindowLogic.PpRightSideMirrorState -> CpSaRightSideMirror.PpSideMirrorState
    connect CtHwAbIO.PpCsSetRearRightWindowState -> CpSaRearRight.PpCsSetWindowState
    connect CtHwAbIO.PpCsSetRearLeftWindowState -> CpSaRearLeft.PpCsSetWindowState
    connect CtHwAbIO.PpCsSetFrontRightWindowState -> CpSaFrontRight.PpCsSetWindowState
    connect CtHwAbIO.PpCsSetFrontLeftWindowState -> CpSaFrontLeft.PpCsSetWindowState
    connect CtHwAbIO.PpCsGetRearRightWindowState -> CpSsRearRightWindowSwitch.PpCsGetWindowState
    connect CtHwAbIO.PpCsGetRearLeftWindowState -> CpSsRearLeftWindowSwitch.PpCsGetWindowState
    connect CtHwAbIO.PpCsGetFrontRightWindowState -> CpSaFrontRightWindowSwitch.PpCsGetWindowState
    connect CtHwAbIO.PpCsGetFrontLeftWindowState -> CpSaFrontLeftWindowSwitch.PpCsGetWindowState
    connect CpSaWindowLockSwitch.PpWindowLockedSwitch -> CpCoWindowLogic.PpWindowLockedSwitch
    connect CtHwAbIO.PpCsSetLeftSideMirrorState -> CpSaLeftSideMirror.PpCsSetSideMirrorState
    connect CtHwAbIO.PpCsSetRightSideMirrorState -> CpSaRightSideMirror.PpCsSetSideMirrorState
package /EndToEndProtections
  end to end protection set EndToEndProtectionSet
package /Systems
  system DoorECU
    root-software-compositions:
      root sw composition prototype EcuSwComposition: software-composition=ECU_Composition
